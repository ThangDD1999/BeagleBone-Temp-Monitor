/dts-v1/;
/plugin/;

/* Include các file định nghĩa của Kernel */
#include <dt-bindings/pinctrl/am33xx.h>
#include <dt-bindings/gpio/gpio.h>

/ {
    compatible = "ti,am335x-bone-black", "ti,am335x";

    fragment@0 {
        target = <&am33xx_pinmux>;

        __overlay__ {
            dht11_pins: pinmux_dht11_pins {
                pinctrl-single,pins = <
                    AM33XX_PADCONF(AM335X_PIN_GPMC_BEN1, PIN_INPUT_PULLUP, MUX_MODE7)
                >;
            };
        };
    };

    fragment@1 {
        target-path = "/";

        __overlay__ {
            my_dht11_device {
                compatible = "custom,my-dht11";
                pinctrl-names = "default";
                pinctrl-0 = <&dht11_pins>;
                gpios = <&gpio1 28 0>;
                status = "okay";
            };
        };
    };
};